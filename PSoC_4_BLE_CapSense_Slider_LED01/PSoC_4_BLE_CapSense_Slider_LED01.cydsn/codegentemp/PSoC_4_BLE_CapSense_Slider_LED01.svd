# CY8C4247LQI_BL483 register map
File version: 0.1
PSoC 4200 BLE
Registers are 8-bit, read-write, no defined reset value unless marked. A register's access mark holds for its fields unless they carry their own. Offsets are from the block's base; lines under a group give offsets from that group; [hi:lo] are bit positions; {n}, {i} and the like mark numbered series; 'fields as' and 'values as' point back to an identical list; <NAME> marks a mode.

## Memory map
0x00000000 PrISM_1 — PrISM
0x00000000 PrISM_2 — PrISM
0x00000000 CapSense_IDAC1 — IDAC
0x00000000 CapSense_IDAC2 — IDAC

## PrISM_1 — PrISM
Base 0x00000000
0x400F0003 PrISM_SEED — Current seed value
0x400F0013 PrISM_POLYNOM — Polynomial
0x400F0023 PrISM_DENSITY0 — Pulse Density 0
0x400F0033 PrISM_DENSITY1 — Pulse Density 1
0x400F0043 PrISM_SEED_COPY — Start seed value
0x400F0073 PrISM_CONTROL 3-bit — Control register
  [2] compare_type1 — XX
  [1] compare_type0
  [0] ctrl_enable

## PrISM_2 — PrISM
Base 0x00000000
0x400F0002 PrISM_SEED — Current seed value
0x400F0012 PrISM_POLYNOM — Polynomial
0x400F0022 PrISM_DENSITY0 — Pulse Density 0
0x400F0032 PrISM_DENSITY1 — Pulse Density 1
0x400F0042 PrISM_SEED_COPY — Start seed value
0x400F0072 PrISM_CONTROL 3-bit — Control register
  [2] compare_type1 — XX
  [1] compare_type0
  [0] ctrl_enable

## CapSense_IDAC1 — IDAC
Base 0x00000000
Same registers: CapSense_IDAC2 0x00000000
0x40280004 CSD_IDAC_POLARITY 32-bit
0x40280008 CSD_IDAC 32-bit
0x4028FF00 CSD_TRIM1 32-bit — CSD IDAC TRIM1
0x4028FF04 CSD_TRIM2 32-bit — CSD IDAC TRIM2
